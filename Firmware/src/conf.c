/***************************************************************************//**
 * @file        conf.c
 * @author      Created: CLU
 * @brief       device configuration driver
 ******************************************************************************/

/* Includes ------------------------------------------------------------------*/
#include "conf.h"
#include "teco.h"
#include "crc.h"

/* Private typedef -----------------------------------------------------------*/
/* Private define ------------------------------------------------------------*/
#define CONF_FLASH_BASE_ADDRESS   0x08000000
#define CONF_BOARD_CONFIG_PAGE            19
#define CONF_FIRST_PAGE                   20
#define CONF_FLASH_PAGESIZE             1024
#define CONF_FRAME_MAX_SIZE              128
#define CONF_CONFIG_START_ADDRESS  CONF_FLASH_BASE_ADDRESS + (CONF_FIRST_PAGE*CONF_FLASH_PAGESIZE)

const uint8_t backupConfig[] = {
    0x20, 0x08, 0x00, 0x00, 0x04, 0x00, 0x00, 0x02,
    0x00, 0x00, 0x00, 0x00, 0x00, 0x00, 0x00, 0x00,
    0x00, 0x00, 0x00, 0x00, 0x00, 0x00, 0x00, 0x00,
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    0x70, 0xFF
};

/* Private variables ---------------------------------------------------------*/
const uint8_t* configBaseFlash = (uint8_t*)((uint32_t)CONF_CONFIG_START_ADDRESS);
const uint8_t* configBaseBackup = (uint8_t*)backupConfig;
const uint16_t configMaxFrameSize = CONF_FRAME_MAX_SIZE;

uint32_t configFlashSize;
uint32_t configConfigSize;
uint16_t configConfigSizeKB;
uint16_t configConfigNumPages;
uint32_t configTopAddress;

uint32_t confCurrentWriteAddress  = (uint32_t)CONF_CONFIG_START_ADDRESS;
uint32_t confCurrentReadAddress   = (uint32_t)CONF_CONFIG_START_ADDRESS;

bool configOk = false;

boardConfig_t boardConfig;

/* Private functions ---------------------------------------------------------*/

/*******************************************************************************
 * config_boardConfigRead
 ******************************************************************************/
bool config_boardConfigRead(void) {

    uint32_t addr = CONF_FLASH_BASE_ADDRESS + (CONF_BOARD_CONFIG_PAGE*CONF_FLASH_PAGESIZE);
    uint16_t crc  = *((uint16_t*)addr);
    uint16_t byteLen  = sizeof(boardConfig_t);
    uint16_t wordLen  = (byteLen+1) >> 1;

    uint16_t crcCalc  = crc_calc((uint8_t*)(addr+2), byteLen);
    if (crcCalc != crc) return false;

    uint16_t* pC = (uint16_t*)&boardConfig;
    uint16_t* pF = (uint16_t*) addr;

    for (uint16_t i=0; i<wordLen; i++) pC[i] = pF[i+1];

    return true;
}

/*******************************************************************************
 * config_boardConfigWrite
 ******************************************************************************/
void config_boardConfigWrite(void) {

    uint32_t addr = CONF_FLASH_BASE_ADDRESS + (CONF_BOARD_CONFIG_PAGE*CONF_FLASH_PAGESIZE);
    uint16_t byteLen  = sizeof(boardConfig_t);
    uint16_t wordLen  = (byteLen+1) >> 1;
    uint16_t crc = crc_calc((uint8_t*)&boardConfig, byteLen);

    HAL_FLASH_Unlock();

    //erase config page
    FLASH_EraseInitTypeDef EraseInitStruct;
	uint32_t PAGEError;
    EraseInitStruct.TypeErase   = FLASH_TYPEERASE_PAGES;
	EraseInitStruct.PageAddress = addr;
	EraseInitStruct.NbPages     = 1;
    if (HAL_FLASHEx_Erase(&EraseInitStruct, &PAGEError) != HAL_OK) return;
    
    //program crc
    HAL_FLASH_Program(FLASH_TYPEPROGRAM_HALFWORD, addr, crc);

    uint16_t* p = (uint16_t*)&boardConfig;

    //rogram data
    for (uint16_t i=0; i<wordLen; i++) {
        addr += 2;
        HAL_FLASH_Program(FLASH_TYPEPROGRAM_HALFWORD, addr, p[i]);
    }

    HAL_FLASH_Lock();
}

/*******************************************************************************
 * config_boardConfigFactoryDefault
 ******************************************************************************/
void config_boardConfigFactoryDefault(void) {
    boardConfig.batteryMinVoltage = 0;
    config_boardConfigWrite();
}

/*******************************************************************************
 * config_erase
 ******************************************************************************/
bool config_erase(void) {

    HAL_FLASH_Unlock();

    //erase config pages
    FLASH_EraseInitTypeDef EraseInitStruct;
	uint32_t PAGEError;
    EraseInitStruct.TypeErase   = FLASH_TYPEERASE_PAGES;
	EraseInitStruct.PageAddress = CONF_FLASH_BASE_ADDRESS + (CONF_FIRST_PAGE*CONF_FLASH_PAGESIZE);
	EraseInitStruct.NbPages     = configConfigNumPages;
    if (HAL_FLASHEx_Erase(&EraseInitStruct, &PAGEError) != HAL_OK) return false;

    HAL_FLASH_Lock();

    return true;
}

/*******************************************************************************
 * config_resetPointers
 ******************************************************************************/
void config_resetPointers(void) {
    confCurrentWriteAddress  = (uint32_t)CONF_CONFIG_START_ADDRESS;
    confCurrentReadAddress   = (uint32_t)CONF_CONFIG_START_ADDRESS;
}

/*******************************************************************************
 * config_write
 ******************************************************************************/
bool config_write(uint8_t numBytes, uint8_t* pData) {
    
    //prüfe die anzahl bytes
    if (numBytes > CONF_FRAME_MAX_SIZE) return false;
    if (numBytes % 2 != 0) return false;

    //prüfe ob ganzer block innerhalb konfiguration liegt
    uint32_t lastWriteAddress = confCurrentWriteAddress + numBytes - 1;
    if (lastWriteAddress > configTopAddress) return false;

    HAL_FLASH_Unlock();

    uint8_t numWords = numBytes >> 1;
    uint16_t* pConfigData = (uint16_t*)(pData);

    for (uint8_t i=0; i<numWords; i++) {
        //schreibe word ins flash
        if (HAL_FLASH_Program(FLASH_TYPEPROGRAM_HALFWORD, confCurrentWriteAddress, pConfigData[i]) == HAL_ERROR) {
            HAL_FLASH_Lock();
            return false;
        }

        //prüfe ob word richtig geschrieben wurde
        uint16_t* pTest = (uint16_t*)confCurrentWriteAddress;
        if (*pTest != pConfigData[i]) {
            HAL_FLASH_Lock();
            return false;
        }

        confCurrentWriteAddress += 2;
    }

    HAL_FLASH_Lock();
    return true;
}

/*******************************************************************************
 * config_readBytes
 ******************************************************************************/
uint8_t* config_readBytes(uint8_t numBytes) {

    if (numBytes > CONF_FRAME_MAX_SIZE) return null;
    if (numBytes % 2 != 0) return null;
    if (confCurrentReadAddress > configTopAddress) return null;
    if (confCurrentReadAddress + numBytes > configTopAddress) return null;

    uint8_t* ret = (uint8_t*)confCurrentReadAddress;
    confCurrentReadAddress += numBytes;
    return ret;
}


/*******************************************************************************
 * config_init
 ******************************************************************************/
void config_init(void) {

    uint32_t configFlashSizeKB;

    configFlashSizeKB    = (uint32_t)(*((uint16_t*)0x1ffff7e0));
    configFlashSize      = configFlashSizeKB << 10;
    configConfigSize     = configFlashSize - (CONF_FIRST_PAGE*CONF_FLASH_PAGESIZE);
    configConfigSizeKB   = configConfigSize >> 10;
    configConfigNumPages = configConfigSize / CONF_FLASH_PAGESIZE;
    configTopAddress     = CONF_CONFIG_START_ADDRESS + configConfigSize - 1;

}

